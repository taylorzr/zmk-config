#include <behaviors.dtsi>
#include <dt-bindings/zmk/keys.h>
#include <dt-bindings/zmk/bt.h>

/ {
  keymap {
      compatible = "zmk,keymap";

      // default_layer {
      //     display-name = "Base";
      //     bindings = <
      //         &kp B &kp A &kp N &kp A &kp N &kp A &kp EXCL &kp N1
      //     >;
      // };

      default_layer {
          display-name = "Base";
          bindings = <
              &kp C_PP &kp SPACE &kp LEFT &kp RIGHT &kp DOWN &kp UP &kp C_PREV &kp C_NEXT
          >;
      };
  };
};
