## config/boards/shields/lil_chonky_bois/Kconfig.defconfig
```kconfig
if SHIELD_LIL_CHONKY_BOIS_LEFT

config ZMK_KEYBOARD_NAME
    default "Lil Chonky Bois"

config ZMK_SPLIT_BLE_ROLE_CENTRAL
    default y

endif

if SHIELD_LIL_CHONKY_BOIS_RIGHT

config ZMK_KEYBOARD_NAME
    default "Lil Chonky R"

endif

if SHIELD_LIL_CHONKY_BOIS_LEFT || SHIELD_LIL_CHONKY_BOIS_RIGHT

config ZMK_SPLIT
    default y

endif
```

## config/boards/shields/lil_chonky_bois/Kconfig.shield
```kconfig
config SHIELD_LIL_CHONKY_BOIS_LEFT
    def_bool $(shields_list_contains,lil_chonky_bois_left)

config SHIELD_LIL_CHONKY_BOIS_RIGHT
    def_bool $(shields_list_contains,lil_chonky_bois_right)
```

## config/west.yml
```yaml
manifest:
  remotes:
    - name: zmkfirmware
      url-base: https://github.com/zmkfirmware
    - name: urob
      url-base: https://github.com/urob
  projects:
    - name: zmk
      remote: zmkfirmware
      revision: main
      import: app/west.yml
    - name: zmk-auto-layer
      remote: urob
      # revision: v0.1 # set to same version as zmk
      revision: main
  self:
    path: config
```
